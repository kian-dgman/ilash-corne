## config/west.yml
```yaml
manifest:
  remotes:
    - name: zmkfirmware
      url-base: https://github.com/zmkfirmware
    - name: mctechnology17
      url-base: https://github.com/mctechnology17
    - name: eyelash
      url-base: https://github.com/a741725193
    - name: manna-harbour
      url-base: https://github.com/manna-harbour
  projects:
    - name: zmk
      remote: zmkfirmware
      revision: v0.3.0
      import: app/west.yml
    - name: zmk-nice-oled
      remote: mctechnology17
      revision: main
    - name: zmk-board-eyelash
      remote: eyelash
      revision: main
    - name: miryoku_zmk
      remote: manna-harbour
      revision: master
  self:
    path: config
```
